## loader/Kconfig
```kconfig
#
# Copyright (c) Arduino s.r.l. and/or its affiliated companies
#
# SPDX-License-Identifier: Apache-2.0
#

config PINCTRL
	select PINCTRL_NON_STATIC


config LLEXT_HEAP_REGION
	string "LLEXT heap memory region"
	depends on CODE_DATA_RELOCATION
	help
	  Specify the memory region for LLEXT heap.

config MAIN_STACK_REGION
	string "Main stack memory region"
	depends on CODE_DATA_RELOCATION
	help
	  Specify the memory region for main stack.

menu "Flash Padding Options"

choice FLASH_PADDING_STRATEGY
    prompt "Flash padding strategy"
    optional
    depends on !LINKER_LAST_SECTION_ID
	 depends on !MCUBOOT
    help
      Select how the firmware image is padded. Requires CONFIG_LINKER_LAST_SECTION_ID=n.

config FLASH_ALIGN_BASED_ON_DT_ERASE_DIM
    bool "Align based on Devicetree erase block size"

config CUSTOM_FLASH_ALIGN_ACTIVE
    bool "Align to a custom dimension"

endchoice

config CUSTOM_FLASH_ALIGN
    int "Custom flash alignment boundary"
    depends on CUSTOM_FLASH_ALIGN_ACTIVE
    default 1024
    help
      The dimension to align the padding to, disregarding the Devicetree block size.

endmenu

config LOADER_SKETCH_IN_MCUBOOT_IMAGE
	bool "Sketch is appended to the loader in the MCUboot image"
	depends on BOOTLOADER_MCUBOOT
	help
	  Load the sketch from slot0 at the offset zephyr-sketch-tool --squash
	  stores after the MCUboot header, instead of from a user_sketch
	  partition.

config LOADER_TRIAL_WINDOW_MS
	int "Time a test image has to confirm itself (0: no trial)"
	depends on MCUBOOT_IMG_MANAGER && APP_WATCHDOG_ENFORCED
	default 60000 if MCUBOOT_BOOTLOADER_MODE_SWAP_USING_OFFSET
	default 0
	help
	  With MCUboot swap modes an update first runs as a test. The sketch
	  must call ota_confirm() within this time, or the watchdog thread
	  reboots and MCUboot swaps the previous image back. A hang that
	  stops the thread is caught by the watchdog itself.

config LOADER_DFU_MODE
	bool "Loader USB DFU mode entered by the 1200-bps touch"
	depends on USB_DEVICE_STACK_NEXT && MCUBOOT_IMG_MANAGER && RETENTION_BOOT_MODE
	select USBD_DFU
	help
	  The 1200-bps touch reboots into the loader's own DFU mode (instead
	  of MCUboot's), with a "complete_image" and a "sketch" alternate; both
	  write slot1 and request a permanent MCUboot update.

if LOADER_DFU_MODE

config LOADER_DFU_BOOT_MODE
	hex "Retention boot mode value requesting the loader DFU mode"
	default 0x4c

config LOADER_DFU_PID
	hex "USB product ID of the loader DFU mode"
	default 0x0
	help
	  0 uses USB_DEVICE_PID + 0x100.

endif

config APP_WATCHDOG_ENFORCED
    bool "Hardware watchdog enforced by Sysbuild (MCU Boot required)"
    default n
    help
      This is automatically set to 'y' by Sysbuild if the secure 
      watchdog parameters are injected into MCUBoot.

config APP_WATCHDOG_TIMEOUT_MS
    int "Watchdog timeout injected by Sysbuild"
    default 20000

source "Kconfig.zephyr"
rsource "ota/Kconfig"
```

## loader/mcuboot_hooks/Kconfig
```kconfig
# Copyright (c) Arduino s.r.l. and/or its affiliated companies
# SPDX-License-Identifier: Apache-2.0

config ARDUINO_MCUBOOT_DFU_BOOT_MODE
	bool "USB DFU on a retention boot mode request"
	depends on MCUBOOT && BOOT_USB_DFU && RETENTION_BOOT_MODE
	select BOOT_GO_HOOKS
	select MCUBOOT_ACTION_HOOKS
	select REBOOT
	help
	  When the bootloader boot mode is set (1200-bps touch, double tap),
	  wait in USB DFU without a timeout; MCUboot keeps feeding the
	  watchdog. Without a bootable image, reboot into the same mode.

config ARDUINO_MCUBOOT_DFU_FADE_LED
	bool "Fade the mcuboot-fade-led0 LED while waiting in USB DFU"
	depends on ARDUINO_MCUBOOT_DFU_BOOT_MODE
	depends on $(dt_alias_enabled,mcuboot-fade-led0)
	select PWM
```

## loader/ota/Kconfig
```kconfig
#
# Copyright (c) Arduino s.r.l. and/or its affiliated companies
#
# SPDX-License-Identifier: Apache-2.0
#

menuconfig OTA
	bool "Enable sketch and loader updates"
	depends on FILE_SYSTEM || BOOTLOADER_MCUBOOT
	select REBOOT
	help
	  Let the sketch stage an update (ota.h) that is installed on the next
	  boot, by the loader from a file or by MCUboot from its secondary slot.

if OTA

choice OTA_BACKEND
	prompt "Where updates are staged"
	default OTA_BACKEND_MCUBOOT if BOOTLOADER_MCUBOOT
	default OTA_BACKEND_FS

config OTA_BACKEND_FS
	bool "File in a filesystem"
	depends on FILE_SYSTEM
	select RTC if SOC_SERIES_STM32H7X
	help
	  The update is written to OTA_SKETCH_UPDATE_PATH or OTA_LOADER_UPDATE_PATH.
	  The loader installs a sketch update at boot, the mbed bootloader a
	  loader update.

config OTA_BACKEND_MCUBOOT
	bool "MCUboot secondary slot"
	depends on BOOTLOADER_MCUBOOT
	select FLASH_MAP
	select STREAM_FLASH
	# MCUBOOT_IMG_MANAGER is the image manager choice's default.
	select IMG_MANAGER
	select IMG_ERASE_PROGRESSIVELY
	help
	  The update is a full MCUboot image (loader + sketch) written to
	  slot1_partition; MCUboot verifies and installs it on the next boot.

endchoice

if OTA_BACKEND_FS

config OTA_SKETCH_UPDATE_PATH
	string "The path it is looked for ota"
	default "/ota:/UPDATE_SKETCH.BIN"
	help
	  the path that is checked for a sketch new binary

config OTA_SKETCH_TEMP_PATH_POSTFIX
	string "temporary file name postfix for sketch ota not ready"
	default ".TEMP"
	help
	  String that is appended to sketch ota filename when it is still not ready to be loaded,
	  a rename operation is required to make the ota file enabled for next reboot

config OTA_LOADER_UPDATE_PATH
	string "The path it is looked for ota"
	default "/ota:/UPDATE.BIN"
	help
	  the path that is checked for the loader new binary

config OTA_LOADER_TEMP_PATH_POSTFIX
	string "temporary file name postfix for loader ota not ready"
	default "" if SOC_SERIES_STM32H7X
	default ".TEMP"
	help
	  String that is appended to loader ota filename when it is still not ready to be loaded,
	  a rename operation is required to make the ota file enabled for next reboot

config OTA_TRANSCRIPTION_CHUNK_SIZE
	int "The size of the stack allocated chunk in bytes for transcription"
	default 1024
	help
	  The size of the stack allocated chunk in bytes for ota file transcription

endif # OTA_BACKEND_FS

module = OTA
module-str = OTA
module-help = Sets log level for OTA
source "subsys/logging/Kconfig.template.log_config"

endif
```
