## loader/Kconfig
```kconfig
#
# Copyright (c) Arduino s.r.l. and/or its affiliated companies
#
# SPDX-License-Identifier: Apache-2.0
#

config PINCTRL
	select PINCTRL_NON_STATIC


config LLEXT_HEAP_REGION
	string "LLEXT heap memory region"
	depends on CODE_DATA_RELOCATION
	help
	  Specify the memory region for LLEXT heap.

config MAIN_STACK_REGION
	string "Main stack memory region"
	depends on CODE_DATA_RELOCATION
	help
	  Specify the memory region for main stack

config ARDUINO_NATIVE_SKETCH_BASE
	hex "Sketch load address on native targets"
	depends on ARCH_POSIX
	default 0x10000000
	help
	  Fixed host address where the sketch file given with --sketch is
	  mapped. Static sketches are linked for this address.

config ARDUINO_NATIVE_SKETCH_MAX_SIZE
	hex "Maximum sketch size on native targets"
	depends on ARCH_POSIX
	default 0x400000

menu "Flash Padding Options"

choice FLASH_PADDING_STRATEGY
    prompt "Flash padding strategy"
    optional
    depends on !LINKER_LAST_SECTION_ID
	 depends on !MCUBOOT
    help
      Select how the firmware image is padded. Requires CONFIG_LINKER_LAST_SECTION_ID=n.

config FLASH_ALIGN_BASED_ON_DT_ERASE_DIM
    bool "Align based on Devicetree erase block size"

config CUSTOM_FLASH_ALIGN_ACTIVE
    bool "Align to a custom dimension"

endchoice

config CUSTOM_FLASH_ALIGN
    int "Custom flash alignment boundary"
    depends on CUSTOM_FLASH_ALIGN_ACTIVE
    default 1024
    help
      The dimension to align the padding to, disregarding the Devicetree block size.

endmenu

config LOADER_TRIAL_WINDOW_MS
	int "Time a test image has to confirm itself (0: no trial)"
	depends on MCUBOOT_IMG_MANAGER && APP_WATCHDOG_ENFORCED
	default 60000 if MCUBOOT_BOOTLOADER_MODE_SWAP_USING_OFFSET
	default 0
	help
	  With MCUboot swap modes an update first runs as a test. The sketch
	  must call ota_confirm() within this time, or the watchdog thread
	  reboots and MCUboot swaps the previous image back. A hang that
	  stops the thread is caught by the watchdog itself.

config APP_WATCHDOG_ENFORCED
    bool "Hardware watchdog enforced by Sysbuild (MCU Boot required)"
    default n
    help
      This is automatically set to 'y' by Sysbuild if the secure 
      watchdog parameters are injected into MCUBoot.

config APP_WATCHDOG_TIMEOUT_MS
    int "Watchdog timeout injected by Sysbuild"
    default 20000
config LOADER_DFU_MAGIC
  int "Number used to activate the loader DFU via memory retention"
  range 0 255
  default 120

config USE_DFU_FLASH_UPDATES
    bool "Enable USB DFU flash updates (loader and sketch images)"
    default y if BOARD_ARDUINO_MEZZA
    help
      Enables the USB DFU class used to flash updates to the loader image
      and the user sketch image.

if USE_DFU_FLASH_UPDATES

config LOADER_DFU_BOOT_MODE
    hex "Retention boot mode value requesting the loader DFU (0: retention2)"
    default 0
    help
      0 requests the loader DFU with LOADER_DFU_MAGIC in the retention2
      area. Boards without retention2 use this boot-mode value instead
      (needs RETENTION_BOOT_MODE).

config LOADER_DFU_PID
    hex "USB product ID of the loader DFU mode"
    default 0x0
    help
      0 uses USB_DEVICE_PID + 0x100.

config LOADER_DFU_SLOT1_IMAGE_OFFSET
    hex "Offset of the image in slot1"
    default 0x0
    help
      Swap-using-offset keeps the image one sector into slot1: set it to
      that sector size. The .dfu file then starts with as many erased bytes,
      which the loader drops.

endif

config USE_DFU_FADING_BLINK
    bool "Enable fading LED blink while waiting for a DFU update"
    default y if BOARD_ARDUINO_MEZZA
    depends on USE_DFU_FLASH_UPDATES
    help
      Blinks a PWM-driven LED with a fade effect while the board is waiting
      for a DFU update to be applied. Requires a "fade_led" alias in the
      device tree.

config WAIT_FOR_DFU_IF_SKETCH_IS_NOT_VALID
    bool "Wait for a DFU update when the sketch header is invalid"
    default y if BOARD_ARDUINO_MEZZA
    depends on USE_DFU_FLASH_UPDATES
    help
      If the sketch stored in flash has an invalid header, block and wait
      for a DFU update instead of attempting to start it.

config USE_LOADER_AND_BINARY_SQUASHED
    bool "Loader and sketch share a single squashed flash image"
    default y if BOARD_ARDUINO_MEZZA
    depends on USE_DFU_FLASH_UPDATES
    help
      Enable this when the loader and the sketch are packed together into
      a single flash image whose layout (sketch offset, erase size, block
      count and padding) is only known at runtime. When enabled, the
      loader reads this layout from the image header via
      retrieve_flash_info() instead of relying on statically retained
      sketch_base_addr/sketch_max_size symbols. This layout is only
      produced to support the dynamic sketch DFU alternate, hence the
      dependency on USE_DFU_FLASH_UPDATES.

source "Kconfig.zephyr"
rsource "ota/Kconfig"
```

## loader/native_sim/ota_sim/Kconfig
```kconfig
# Copyright (c) Arduino s.r.l. and/or its affiliated companies
# SPDX-License-Identifier: Apache-2.0

config ARDUINO_RETAINED_EEPROM
	bool "Retained memory on an EEPROM (native_sim)"
	default y
	depends on DT_HAS_ARDUINO_RETAINED_EEPROM_ENABLED
	depends on RETAINED_MEM
	select EEPROM
	help
	  Retained memory kept in a range of an EEPROM. On native_sim the
	  simulated EEPROM is a host file (--eeprom), so the boot mode and
	  the bootloader info survive the "reboot" from MCUboot to the
	  loader, which are two processes.

config ARDUINO_RETAINED_EEPROM_INIT_PRIORITY
	int "Init priority of the EEPROM retained memory"
	default 60
	depends on ARDUINO_RETAINED_EEPROM
	help
	  After the EEPROM (EEPROM_INIT_PRIORITY), before the retention
	  areas (RETENTION_INIT_PRIORITY).
```

## loader/native_sim/ota_sim/dts/bindings/retained_mem/arduino,retained-eeprom.yaml
```yaml
# Copyright (c) Arduino s.r.l. and/or its affiliated companies
# SPDX-License-Identifier: Apache-2.0

description: Retained memory area in a range of an EEPROM.

compatible: "arduino,retained-eeprom"

include: base.yaml

properties:
  "#address-cells":
    const: 1

  "#size-cells":
    const: 1

  eeprom:
    type: phandle
    required: true
    description: EEPROM holding the area.

  offset:
    type: int
    default: 0
    description: Start of the area in the EEPROM.

  size:
    type: int
    required: true
    description: Size of the area.
```
